// Copyright 2022 Manna Harbour
// https://github.com/manna-harbour/miryoku

#define MIRYOKU_ALPHAS_QWERTY
#define MIRYOKU_EXTRA_QWERTY
#define MIRYOKU_TAP_QWERTY
//#define MIRYOKU_NAV_VI

#include "../miryoku/mapping/38/totem.h"
#include "../miryoku/miryoku.dtsi"
