## config/west.yml
```yaml
manifest:
  remotes:
    - name: genteure
      url-base: https://github.com/Genteure
  projects:
    - name: zmk
      remote: genteure
      revision: feat/battery-reporting
      import: app/west.yml
  self:
    path: config
```
